#include <WiFi.h>
#include <HTTPClient.h>
#include <Keypad.h>
#include <Wire.h>
#include <LiquidCrystal.h>
#include <ArduinoJson.h>
#include <U8g2lib.h> 
#include <NTPClient.h>
#include <string>
#include <Adafruit_GFX.h>
#include <Adafruit_PCD8544.h>

#define ROW_NUM 4
#define COL_NUM 4

#define rs   15
#define enable   2
#define d4   4
#define d5   5
#define d6   18
#define d7   19

#define SDA_PIN_2 21
#define SCL_PIN_2 22

#define SDA_PIN_3 13
#define SCL_PIN_3 23

#define NTP_SERVER     "pool.ntp.org"
#define UTC_OFFSET     -8
#define UTC_OFFSET_DST -7

WiFiUDP ntpUDP;
NTPClient timeClient(ntpUDP, NTP_SERVER, UTC_OFFSET * 3600, 60000);

const String url = // use your own Lambda function here
const byte ROWS = 4;
const byte COLS = 4;
char keys[ROWS][COLS] = {
  { '1', '2', '3', 'A' },
  { '4', '5', '6', 'B' },
  { '7', '8', '9', 'C' },
  { '*', '0', '#', 'D' }
};

byte pin_rows[ROWS] = {12, 14, 27, 26};
byte pin_cols[COLS] = {25, 33, 32, 35};

Keypad keypad = Keypad(makeKeymap(keys), pin_rows, pin_cols, ROWS, COLS);
U8G2_SH1106_128X64_NONAME_F_HW_I2C u8g2(U8G2_R0, SDA_PIN_2, SCL_PIN_2, /* reset=*/ U8X8_PIN_NONE);
U8G2_SH1106_128X64_NONAME_F_HW_I2C u8g3(U8G2_R0, SDA_PIN_3, SCL_PIN_3); 

//U8G2_SSD1306_128X64_NONAME_1_SW_I2C u8g2_2(U8G2_R0, 23, 13, /* reset=*/ U8X8_PIN_NONE);
//U8G2_SSD1306_128X64_NONAME_1_SW_I2C u8g2_1(U8G2_R0, 22, 21, /* reset=*/ U8X8_PIN_NONE);

LiquidCrystal lcd(rs, enable, d4, d5, d6, d7);
String input = "";

byte newbus_bitmap[] = {
  0xff, 0xff, 0xff, 0xff, 0xff, 0xff, 0xff, 0xff, 0xff, 0xff, 0xff, 0xff, 0xff, 0xff, 0xff, 0xff, 
	0xff, 0xff, 0xff, 0xff, 0xff, 0xff, 0xff, 0xff, 0xff, 0xff, 0xff, 0xff, 0xff, 0xff, 0xff, 0xff, 
	0x00, 0x00, 0x00, 0x00, 0x00, 0x00, 0x00, 0x00, 0x00, 0x00, 0x00, 0x00, 0x00, 0x00, 0x00, 0xc0, 
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	0xff, 0xff, 0xff, 0xff, 0xff, 0xff, 0xff, 0xff, 0xff, 0xff, 0xff, 0xff, 0xff, 0xff, 0xff, 0xff
};

void setup() {
  lcd.begin(16, 2);
  Serial.begin(115200);
  
  Wire.begin(SDA_PIN_3, SCL_PIN_3);
  u8g3.begin();
  

  WiFi.begin(ssid, password, 6);

  lcd.print("Wifi Connecting");
  while (WiFi.status() != WL_CONNECTED) {
    delay(500);
    Serial.print(".");
  }
  lcd.clear();
  Serial.println("Connected to WiFi");
  lcd.print("Enter Stop ID:");

  u8g2.begin();
  u8g2.clearBuffer();
  u8g2.drawXBMP(0, 0, 128, 64, newbus_bitmap);
  u8g2.sendBuffer();

  u8g3.begin();
  u8g3.setDisplayRotation(U8G2_R2);
  u8g3.clearBuffer();
  u8g3.setFont(u8g2_font_6x10_tf);
  u8g3.drawStr(10, 10, "WIFI: Connected");
  String ip = "IP: " + WiFi.localIP().toString();
  u8g3.drawStr(10, 20, ip.c_str());
  u8g3.drawStr(10, 30, "TRANSIT REGION:");
  u8g3.drawStr(10, 40, "[1] Puget Sound, WA");
  u8g3.sendBuffer();
  
}

unsigned long lastKeyPressTime = 0;
unsigned long retrieveInterval = 1000;
bool isRetrievingData = false;
String busID;

void loop() {
  timeClient.update();
  String formattedTime = timeClient.getFormattedTime();
  u8g3.setDrawColor(0);
  u8g3.drawBox(0, 60, 128, 10);
  u8g3.setDrawColor(1);
  u8g3.drawStr(10, 60, formattedTime.c_str()); 
  u8g3.sendBuffer();

  char key = keypad.getKey();
  if (key) {
    input += key;
    lcd.clear();
    lcd.print("ID: ");
    lcd.print(input);

    if (key == '#') {
      busID = input.substring(0, input.length() - 1); 
      lcd.clear();
      lcd.print("Retrieving data...");
      isRetrievingData = true; 
      lastKeyPressTime = millis();
      input = ""; 
    }
  }

  if (isRetrievingData) {
    if (millis() - lastKeyPressTime >= retrieveInterval) {
      getStopData(busID);
      lcd.clear();
      lcd.print("Enter Stop ID: ");
      isRetrievingData = false;
    }
  }
}

void getStopData(String busID) {
  HTTPClient http;
  http.useHTTP10(true);
  http.begin(url);

  http.addHeader("Content-Type", "application/json");

  String postData = "{\"id\":\"" + busID + "\"}";

  int httpResponseCode = http.POST(postData);

  if (httpResponseCode > 0) {
    Serial.print("Response code: ");
    Serial.println(httpResponseCode);

    String response = http.getString(); 
    Serial.println("Response: ");
    Serial.println(response);

    DynamicJsonDocument doc(2048);
    DeserializationError error = deserializeJson(doc, response);
    
    if (error) {
      Serial.print("Error parsing JSON: ");
      Serial.println(error.f_str());
      return;

    } else {
      String busData = doc["body"];
      const char* body = doc["body"];
      StaticJsonDocument<256> bodyDoc;
      error = deserializeJson(bodyDoc, body);

      if (error) {
          lcd.clear();
          lcd.print("Body Parse Fail");
          return;
      }
    
      int dataSize = bodyDoc.size();
      String* busdata = new String[dataSize];
      for(int i = 0; i< dataSize; i++) {
        busdata[i] = bodyDoc[i].as<String>();
      }
      outputStopData(busdata, dataSize);
    }

  } else {
    Serial.print("Error in HTTP request: ");
    Serial.println(httpResponseCode);
    return;
  }
  http.end();
}

void outputStopData(String* busdata, int dataSize) {
  for(int i = 0; i < dataSize; i += 2) {
    lcd.clear();
    lcd.setCursor(0,0);
    lcd.print(busdata[i]);

    if(i + 1 < dataSize) {
      lcd.setCursor(0,1);
      lcd.print(busdata[i+1]);
    }

    delay(5000);
  }
}


